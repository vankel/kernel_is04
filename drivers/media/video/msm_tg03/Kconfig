## drivers/media/video/msm_tg03/Kconfig
```kconfig
comment "Camera Sensor Selection"
config TSB143F
	bool "Sensor tsb143f (YUV 12M)"
	depends on TSB_CAMERA_TG03
	default y
	---help---
	  12M YUV Sensor with AutoFocus
```
